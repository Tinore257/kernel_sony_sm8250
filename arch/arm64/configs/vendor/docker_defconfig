## arch/arm64/configs/vendor/docker_defconfig
```kconfig
## essential networking
# Core networking
CONFIG_NETFILTER=y
CONFIG_NETFILTER_ADVANCED=y
CONFIG_NETFILTER_XTABLES=y

# IPv4 networking
CONFIG_INET=y
CONFIG_IP_ADVANCED_ROUTER=y
CONFIG_IP_MULTIPLE_TABLES=y

# IPv4 iptables
CONFIG_IP_NF_IPTABLES=y
CONFIG_IP_NF_FILTER=y
CONFIG_IP_NF_NAT=y
CONFIG_IP_NF_TARGET_MASQUERADE=y

# Connection tracking and NAT
CONFIG_NF_CONNTRACK=y
CONFIG_NF_NAT=y

# Required iptables extensions
CONFIG_NETFILTER_XT_MATCH_ADDRTYPE=y
CONFIG_NETFILTER_XT_MATCH_CONNTRACK=y
CONFIG_NETFILTER_XT_TARGET_MASQUERADE=y

# Virtual networking
CONFIG_VETH=y
CONFIG_BRIDGE=y
CONFIG_BRIDGE_NETFILTER=y


## additional docker
# Cgroups
CONFIG_CGROUPS=y
CONFIG_CGROUP_DEVICE=y
CONFIG_CGROUP_CPUACCT=y
CONFIG_CGROUP_SCHED=y
CONFIG_CPUSETS=y
CONFIG_MEMCG=y
CONFIG_CGROUP_FREEZER=y

# Security
CONFIG_SECCOMP=y
CONFIG_KEYS=y

# Docker storage
CONFIG_OVERLAY_FS=y

# Virtual Ethernet and networking
CONFIG_VETH=y
CONFIG_BRIDGE=y

## Flashed version:
## Docker support

# Namespaces
CONFIG_NAMESPACES=y
CONFIG_UTS_NS=y
CONFIG_IPC_NS=y
CONFIG_PID_NS=y
CONFIG_NET_NS=y
CONFIG_USER_NS=y
CONFIG_CGROUP_NS=y

# Cgroups
CONFIG_CGROUPS=y
CONFIG_CGROUP_PIDS=y
CONFIG_CGROUP_DEVICE=y
CONFIG_CGROUP_CPUACCT=y
CONFIG_CGROUP_SCHED=y
CONFIG_CPUSETS=y
CONFIG_MEMCG=y
CONFIG_CGROUP_FREEZER=y
CONFIG_BLK_DEV_THROTTLING=y
CONFIG_CGROUP_HUGETLB=y
CONFIG_CGROUP_NET_PRIO=y
CONFIG_CFS_BANDWIDTH=y
CONFIG_POSIX_MQUEUE=y

# Netfilter
CONFIG_NETFILTER=y
CONFIG_NETFILTER_XTABLES=y
CONFIG_NF_CONNTRACK=y
CONFIG_NF_NAT=y

# IPv4 iptables and NAT
CONFIG_INET=y
CONFIG_IP_NF_IPTABLES=y
CONFIG_IP_NF_FILTER=y
CONFIG_IP_NF_NAT=y
CONFIG_IP_NF_TARGET_MASQUERADE=y

# Netfilter extensions
CONFIG_NETFILTER_XT_MATCH_ADDRTYPE=y
CONFIG_NETFILTER_XT_MATCH_CONNTRACK=y
CONFIG_NETFILTER_XT_MATCH_IPVS=y

# Bridge networking
CONFIG_BRIDGE=y
CONFIG_BRIDGE_NETFILTER=y
CONFIG_BRIDGE_VLAN_FILTERING=y
CONFIG_VETH=y

# IPVS
CONFIG_IP_VS=m
CONFIG_IP_VS_NFCT=m
CONFIG_IP_VS_PROTO_TCP=m
CONFIG_IP_VS_PROTO_UDP=m
CONFIG_IP_VS_RR=m

# VXLAN
CONFIG_VXLAN=m

# Storage and security
CONFIG_OVERLAY_FS=y
CONFIG_SECCOMP=y
CONFIG_KEYS=y
```
